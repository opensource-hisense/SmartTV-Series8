## kernel/linux-3.10/drivers/net/ethernet/star_mac/Kconfig
```kconfig
#
# MTK network device configuration
#

config NET_VENDOR_MTK
	bool "MTK devices"
	default y
	depends on ETHERNET
	---help---
	  If you have a network (Ethernet) card belonging to this class, say Y
	  and read the Ethernet-HOWTO, available from
	  <http://www.tldp.org/docs.html#howto>.

	  Note that the answer to this question doesn't directly affect the
	  kernel: saying N will just cause the configurator to skip all
	  the questions about Realtek devices. If you say Y, you will be asked for
	  your specific card in the following questions.

if NET_VENDOR_MTK

config MAC539X
	tristate "MT539X Internal MAC support"
	select MII
	depends on ETHERNET
	help
	  This is a driver for MT539X's internal Ethernet mac,
	  Say Y if you want it compiled into the kernel.

	  This driver is also available as a module ( = code which can be
	  inserted in and removed from the running kernel whenever you want).
	  The module will be called mmac.  If you want to compile it as a
	  module, say M here and read <file:Documentation/modules.txt> as well
	  as <file:Documentation/networking/net-modules.txt>.

config MAC5363
	tristate "MT5363 Internal MAC support"
	select MII
	depends on ETHERNET
	help
	  This is a driver for MT5363's internal Ethernet mac,
	  Say Y if you want it compiled into the kernel.

	  This driver is also available as a module ( = code which can be
	  inserted in and removed from the running kernel whenever you want).
	  The module will be called mmac.  If you want to compile it as a
	  module, say M here and read <file:Documentation/modules.txt> as well
	  as <file:Documentation/networking/net-modules.txt>.
	  
config MAC5365_RMII
	tristate "MT5365 Internal MAC support"
	select MII
	depends on ETHERNET
	help
	  This is a driver for MT5365's internal Ethernet mac,
	  Say Y if you want it compiled into the kernel.

	  This driver is also available as a module ( = code which can be
	  inserted in and removed from the running kernel whenever you want).
	  The module will be called mmac.  If you want to compile it as a
	  module, say M here and read <file:Documentation/modules.txt> as well
	  as <file:Documentation/networking/net-modules.txt>.	 

config MAC5366_MII
	tristate "MT5366 Internal MAC support"
	select MII
	depends on ETHERNET
	help
	  This is a driver for MT5365's internal Ethernet mac,
	  Say Y if you want it compiled into the kernel.

	  This driver is also available as a module ( = code which can be
	  inserted in and removed from the running kernel whenever you want).
	  The module will be called mmac.  If you want to compile it as a
	  module, say M here and read <file:Documentation/modules.txt> as well
	  as <file:Documentation/networking/net-modules.txt>.		 
	  
config MAC5395_MII
	tristate "MT5395 Internal MAC support"
	select MII
	depends on ETHERNET
	help
	  This is a driver for MT5395's internal Ethernet mac,
	  Say Y if you want it compiled into the kernel.

	  This driver is also available as a module ( = code which can be
	  inserted in and removed from the running kernel whenever you want).
	  The module will be called mmac.  If you want to compile it as a
	  module, say M here and read <file:Documentation/modules.txt> as well
	  as <file:Documentation/networking/net-modules.txt>.		 
	  
config MAC5396_MII
	tristate "MT5396 Internal MAC support"
	select MII
	depends on ETHERNET
	help
	  This is a driver for MT5396's internal Ethernet mac,
	  Say Y if you want it compiled into the kernel.

	  This driver is also available as a module ( = code which can be
	  inserted in and removed from the running kernel whenever you want).
	  The module will be called mmac.  If you want to compile it as a
	  module, say M here and read <file:Documentation/modules.txt> as well
	  as <file:Documentation/networking/net-modules.txt>.		 

config MAC5368_MII
	tristate "MT5368 Internal MAC support"
	select MII
	depends on ETHERNET
	help
	  This is a driver for MT5368's internal Ethernet mac,
	  Say Y if you want it compiled into the kernel.

	  This driver is also available as a module ( = code which can be
	  inserted in and removed from the running kernel whenever you want).
	  The module will be called mmac.  If you want to compile it as a
	  module, say M here and read <file:Documentation/modules.txt> as well
	  as <file:Documentation/networking/net-modules.txt>.

config MAC5389_MII
	tristate "MT5389 Internal MAC support"
	select MII
	depends on ETHERNET
	help
	  This is a driver for MT5389's internal Ethernet mac,
	  Say Y if you want it compiled into the kernel.

	  This driver is also available as a module ( = code which can be
	  inserted in and removed from the running kernel whenever you want).
	  The module will be called mmac.  If you want to compile it as a
	  module, say M here and read <file:Documentation/modules.txt> as well
	  as <file:Documentation/networking/net-modules.txt>.

config MAC5398_MII
	tristate "MT5398 Internal MAC support"
	select MII
	depends on ETHERNET
	help
	  This is a driver for MT5398's internal Ethernet mac,
	  Say Y if you want it compiled into the kernel.

	  This driver is also available as a module ( = code which can be
	  inserted in and removed from the running kernel whenever you want).
	  The module will be called mmac.  If you want to compile it as a
	  module, say M here and read <file:Documentation/modules.txt> as well
	  as <file:Documentation/networking/net-modules.txt>.
	  
config MAC5880_MII
	tristate "MT5880 Internal MAC support"
	select MII
	depends on ETHERNET
	help
	  This is a driver for MT5880's internal Ethernet mac,
	  Say Y if you want it compiled into the kernel.

	  This driver is also available as a module ( = code which can be
	  inserted in and removed from the running kernel whenever you want).
	  The module will be called mmac.  If you want to compile it as a
	  module, say M here and read <file:Documentation/modules.txt> as well
	  as <file:Documentation/networking/net-modules.txt>.
	  
config MAC5399_MII
	tristate "MT5399 Internal MAC support"
	select MII
	depends on ETHERNET
	help
	  This is a driver for MT5399's internal Ethernet mac,
	  Say Y if you want it compiled into the kernel.

	  This driver is also available as a module ( = code which can be
	  inserted in and removed from the running kernel whenever you want).
	  The module will be called mmac.  If you want to compile it as a
	  module, say M here and read <file:Documentation/modules.txt> as well
	  as <file:Documentation/networking/net-modules.txt>.

config MAC5890_MII
	tristate "MT5890 Internal MAC support"
	select MII
	depends on ETHERNET
	help
	  This is a driver for MT5890's internal Ethernet mac,
	  Say Y if you want it compiled into the kernel.

	  This driver is also available as a module ( = code which can be
	  inserted in and removed from the running kernel whenever you want).
	  The module will be called mmac.  If you want to compile it as a
	  module, say M here and read <file:Documentation/modules.txt> as well
	  as <file:Documentation/networking/net-modules.txt>.

config MAC5882_MII
	tristate "MT5882 Internal MAC support"
	select MII
	depends on ETHERNET
	help
	  This is a driver for MT5882's internal Ethernet mac,
	  Say Y if you want it compiled into the kernel.

	  This driver is also available as a module ( = code which can be
	  inserted in and removed from the running kernel whenever you want).
	  The module will be called mmac.  If you want to compile it as a
	  module, say M here and read <file:Documentation/modules.txt> as well
	  as <file:Documentation/networking/net-modules.txt>.
	  
config MAC5891_MII
	tristate "MT5891 Internal MAC support"
	select MII
	depends on ETHERNET
	help
	  This is a driver for MT5891's internal Ethernet mac,
	  Say Y if you want it compiled into the kernel.

	  This driver is also available as a module ( = code which can be
	  inserted in and removed from the running kernel whenever you want).
	  The module will be called mmac.  If you want to compile it as a
	  module, say M here and read <file:Documentation/modules.txt> as well
	  as <file:Documentation/networking/net-modules.txt>.

config MAC5883_MII
	tristate "MT5883 Internal MAC support"
	select MII
	depends on ETHERNET
	help
	  This is a driver for MT5883's internal Ethernet mac,
	  Say Y if you want it compiled into the kernel.

	  This driver is also available as a module ( = code which can be
	  inserted in and removed from the running kernel whenever you want).
	  The module will be called mmac.  If you want to compile it as a
	  module, say M here and read <file:Documentation/modules.txt> as well
	  as <file:Documentation/networking/net-modules.txt>.
endif # NET_VENDOR_MTK
```

## kernel/linux-3.10/drivers/opm/Kconfig
```kconfig
menu "OPM Support"

config OPM
	bool "ordered power management support"
	default n if ARCH_MT5391
	default n if ARCH_MT5363
	default n if ARCH_MT5365
	default n if ARCH_MT5395
	default n if ARCH_MT5396
	default n if MACH_MT5880
	help
	  support device power management's suspend and resume operation 
	  to be called according to specified order, not depends on device's 
	  registeration sequence.
	  
endmenu
```

## kernel/linux-3.10/drivers/soc/Kconfig
```kconfig
menu "SOC (System On Chip) specific Drivers"

source "drivers/soc/mediatek/Kconfig"

endmenu
```

## kernel/linux-3.10/drivers/usb/mu3d/Kconfig
```kconfig
config USB_MU3D
	depends on USB
	select USB_GADGET_DUALSPEED
#	select USB_GADGET_SUPERSPEED	
	select MUSB_PIO_ONLY
	tristate "MU3D (MTK USB3.0 Device) Controller"
	default n

	
config USB_MU3D_DRV
	depends on USB
	select USB_GADGET_DUALSPEED
	select MUSB_PIO_ONLY
	tristate "MU3D Driver"
	default n

config USB_MU3D_UDC
	depends on USB
	tristate "MU3D udc Driver"
	default n

config USB_MU3D_TEST_DRV
	depends on USB_MU3D
	tristate "MU3D Test Driver"
	default n


config USB_MU3D_O0
	depends on USB_MU3D
	tristate "Apply -O0 compile flag"
	default n
```

## kernel/linux-3.10/drivers/usb/musb_qmu/Kconfig
```kconfig
config USB_MTK_MUSB
	depends on (USB || USB_GADGET)
	tristate 'MTK MUSB support'
	default m
	help
	 Enable MTK MUSB support

config USB_MTK_MUSB_HOST
	depends on USB_MTK_MUSB
	select USB_MUSB_HDRC_HCD
	tristate 'MTK MUSB host mode'
	help
	 Enable MTK MUSB host mode 
	 
config USB_MTK_MUSB_PERIPHERAL
	depends on USB_MTK_MUSB
	select USB_GADGET_MUSB_HDRC
	bool 'MTK MUSB peripheral mode'
	help
	 Enable MTK MUSB peripheral mode 

config USB_MTK_MUSB_DMA
	depends on USB_MTK_MUSB
	select USB_MUSB_INVENTRA_DMA
	tristate 'MTK MUSB DMA support'
	default n
	help
	 Enable MTK MUSB peripheral mode 

config USB_MTK_MUSB_QMU
	depends on USB_MTK_MUSB
	tristate 'MTK MUSB QMU support'
	help
	 Enable MTK MUSB QMU support 	 
```

## kernel/linux-3.10/sound/bluetooth/Kconfig
```kconfig
# ALSA BLUETOOTH drivers

menu "bluetooth sound devices"
    depends on BT

config SND_BLUETOOTH
    tristate "bluetooth alsa driver"
    select SND_HWDEP
    select SND_RAWMIDI
    select SND_PCM
    help
      Say Y here to include support for BT audio devices.

      To compile this driver as a module, choose M here: the module
      will be called snd-bt-audio.

      This driver is the virtual card for HISENSE and NANOSIC
endmenu
```
